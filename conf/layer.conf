## conf/layer.conf
```bitbake
# Copyright (c) 2018 LG Electronics, Inc.

BBPATH ?= ""
# We have a conf and classes directory, add to BBPATH
BBPATH .= ":${LAYERDIR}"
# We have recipe directories, add to BBFILES
BBFILES += "${LAYERDIR}/recipes-*/*/*.bb ${LAYERDIR}/recipes-*/*/*.bbappend"

BBFILE_COLLECTIONS += "meta-ros2-lgsvl"
BBFILE_PATTERN_meta-ros2-lgsvl := "^${LAYERDIR}/"
BBFILE_PRIORITY_meta-ros2-lgsvl = "60"

BBMASK += " \
    meta-webos/recipes-upstreamable/node-inspector \
    meta-webos/recipes-upstreamable/nodejs \
    meta-webos/recipes-upstreamable/nodejs/nodejs \
    meta-webos/recipes-upstreamable/node-gyp \
    meta-webos/recipes-upstreamable/node-gyp/node-gyp-packages-0.12.2 \
    meta-webos/recipes-connectivity/iotivity-node \
    meta-webos/recipes-connectivity/iotivity-node/iotivity-node \
    meta-webos/recipes-webos/nodejs-module-ext \
    meta-webos/recipes-webos/nodejs-module-webos \
    meta-webos-ros2/recipes-webos/com.webos.service.rosbridge \
"

# Override certain PNBLACKLIST items
PNBLACKLIST[poco] = ""
PNBLACKLIST[asio] = ""
PNBLACKLIST[opencv] = ""
```
